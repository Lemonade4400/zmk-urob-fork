/*

ACCENTED CHARACTERS (à, è, ì, ò, ù)
=====================================
This keymap uses Linux's Compose key to produce Italian accented letters.
The accent macros (defined in my-macros.dtsi) send: SCROLLLOCK + ' + <vowel>,
which the OS interprets as a Compose sequence producing a grave accent.

Requirements:
  1. OS keyboard layout set to "US" (plain, NOT "US International" which
     has dead keys that interfere with quote/apostrophe).
  2. SCROLLLOCK mapped as the Compose key in your desktop environment.
     On GNOME:  Settings → Keyboard → Compose Key → Scroll Lock
     On KDE:    System Settings → Input Devices → Keyboard → Advanced →
                Compose key position → Scroll Lock
     On sway/i3: add `input * xkb_options compose:sclk` to your config.

Limitations:
  - This method is Linux-only and depends on the DE/WM Compose key config.
  - It does NOT work on Windows or macOS without additional setup.
  - Shift + accent macro does NOT produce uppercase (À, È, etc.).

Alternative approach (ZMK_UNICODE_PAIR):
  Commit 17abaed implemented OS-independent accents using ZMK_UNICODE_PAIR
  from italian.dtsi, which sends Unicode codepoints directly via:
    - Linux:   Ctrl+Shift+U + hex (works out-of-the-box in GTK/Qt)
    - Windows: RAlt+U + hex (requires WinCompose)
    - macOS:   Alt + hex (requires Unicode Hex Input enabled)
  This approach supports automatic Shift→uppercase (à→À) and does not
  depend on Compose key configuration. However, it was reverted because
  it caused visible flickering during character input.

*/



/* source key position labels */
#include "zmk-helpers/key-labels/42.h"

#include <behaviors.dtsi>
#include <behaviors/num_word.dtsi> // requires auto-layer module
#include <dt-bindings/zmk/keys.h>
// #ifdef CONFIG_WIRELESS
#include <dt-bindings/zmk/bt.h>
#define _BT_SEL_KEYS_ &bt BT_SEL 0 &bt BT_SEL 1 &bt BT_SEL 2 &bt BT_SEL 3 &bt BT_SEL 4
// #else
//     #define _BT_SEL_KEYS_ &trans &trans &trans &trans &trans
// #endif

#include "zmk-helpers/helper.h"
// #include "zmk-helpers/unicode-chars/greek.dtsi"  // only used by leader.dtsi (disabled)
// #include "zmk-helpers/unicode-chars/german.dtsi"  // only used by leader.dtsi (disabled)

#define DEF 0
#define NAV 1
#define FN 2
#define NUM 3
#define SYS 4
#define MOUSE 5
#define CODE 6
#define ACCENTS 7
#define REV_NUM 8
#define SPEED 9
#define MSCRL 10

#define XXX &none
#define ___ &trans

/* Global settings */

#define QUICK_TAP_MS 175

&sk {  // sticky-key config
    release-after-ms = <900>;  // release after 0.9s
    quick-release;             // no double capitalization when rolling keys
};

&sl {  // sticky-layer config
    ignore-modifiers;          // allow chording sticky mods & layers
};

&lt {  // layer-tap config
    flavor = "balanced";
    tapping-term-ms = <200>;
    quick-tap-ms = <QUICK_TAP_MS>;
};

/* Homerow mods */

#define KEYS_L LT0 LT1 LT2 LT3 LT4 LM0 LM1 LM2 LM3 LM4 LB0 LB1 LB2 LB3 LB4  // left hand
#define KEYS_R RT0 RT1 RT2 RT3 RT4 RM0 RM1 RM2 RM3 RM4 RB0 RB1 RB2 RB3 RB4  // right hand
// #ifndef LH2
//    #define THUMBS LH1 LH0 RH0 RH1                                          // thumbs on 34 keys
// #else
    #define THUMBS LH2 LH1 LH0 RH0 RH1 RH2                                  // thumbs on 36+ keys
// #endif

#define MAKE_HRM(NAME, HOLD, TAP, TRIGGER_POS) \
    ZMK_HOLD_TAP(NAME, \
        flavor = "balanced"; \
        tapping-term-ms = <220>; \
        quick-tap-ms = <QUICK_TAP_MS>; \
        require-prior-idle-ms = <100>; \
        bindings = <HOLD>, <TAP>; \
        hold-trigger-key-positions = <TRIGGER_POS>; \
        hold-trigger-on-release; \
    )
MAKE_HRM(hml, &kp, &kp, KEYS_R THUMBS)  // left-hand HRMs
MAKE_HRM(hmr, &kp, &kp, KEYS_L THUMBS)  // right-hand HRMs

// HRM combo hack - workaround for lack of tap-only combos (ZMK issue #544)
#define ZMK_COMBO_8(NAME, TAP, KEYPOS, LAYERS, COMBO_TERM, COMBO_IDLE, HOLD, SIDE) \
    MAKE_HRM(hm_combo_ ## NAME, &kp, TAP, SIDE THUMBS) \
    ZMK_COMBO_6(NAME, &hm_combo_ ## NAME HOLD 0, KEYPOS, LAYERS, COMBO_TERM, COMBO_IDLE)

/* Combos, leader key sequences, mouse emulation */

// some custom behaviors defined before sourcing combos.dtsi

// Alt+Tab swapper, requires PR #1366
ZMK_TRI_STATE(swapper,
    bindings = <&kt LALT>, <&kp TAB>, <&kt LALT>;
    ignored-key-positions = <LT2>;
)

// Alt+Tab swapper, requires PR #1366
ZMK_TRI_STATE(c_swapper,
    bindings = <&kt LCTRL>, <&kp TAB>, <&kt LCTRL>;
    ignored-key-positions = <LT2>;
)

#include "my-macros.dtsi" // some combos uses my-macros so it must be sourced before combos.dtsi

#include "combos.dtsi"  // must be sources after HRM-combo hack
// #include "leader.dtsi" // edit: leader disabled
#include "mouse.dtsi"
#include "extra_keys.h"

// Password macro (generated at build time in private repo)
#if __has_include("password-macro.dtsi")
    #include "password-macro.dtsi"
#else
    ZMK_MACRO(type_password, bindings = <&none>;)
#endif

// Commit hash macro (generated at build time in private repo)
#if __has_include("commit-macro.dtsi")
    #include "commit-macro.dtsi"
#else
    ZMK_MACRO(type_commit, bindings = <&none>;)
#endif

/* Nav cluster */

// long-tap action on hold, short-tap action on all interrupts
#define MT_CORE \
    flavor = "tap-preferred"; \
    tapping-term-ms = <220>; \
    quick-tap-ms = <220>; \
    hold-trigger-key-positions = <0>;

&mt { MT_CORE };
ZMK_HOLD_TAP(mt_home, bindings = <&masked_home>, <&kp>; MT_CORE)
ZMK_HOLD_TAP(mt_end, bindings = <&masked_end>, <&kp>; MT_CORE)
ZMK_HOLD_TAP(mt_eight_up, bindings = <&eight_up>, <&kp>; MT_CORE)
ZMK_HOLD_TAP(mt_eight_down, bindings = <&eight_down>, <&kp>; MT_CORE)

#define NAV_LEFT  &mt_home 0   LEFT    // tap: left  | long-tap: beginning of line
#define NAV_RIGHT &mt_end 0    RIGHT   // tap: right | long-tap: end       of line
#define NAV_UP    &mt_eight_up 0   UP    // tap: up    | long-tap: 8 lines up
#define NAV_DOWN  &mt_eight_down 0 DOWN  // tap: down  | long-tap: 8 lines down
#define NAV_BSPC  &mt LC(BSPC) BSPC    // tap: bspc  | long-tap: delete word backward
#define NAV_DEL   &mt LC(DEL)  DEL     // tap: del   | long-tap: delete word forward

// mask CTRL when holding left/right to avoid accidental jumps to beginning/end of document
#define MASK_MODS(NAME, MODS, BINDING) \
    ZMK_MOD_MORPH(NAME, \
        bindings = <BINDING>, <BINDING>; \
        mods = <MODS>; \
    )
MASK_MODS(masked_home, (MOD_LCTL), &kp HOME)
MASK_MODS(masked_end,  (MOD_LCTL), &kp END)

/* Caps-word, num-word and smart-mouse */

// tap: sticky-shift | shift + tap/ double-tap: caps-word | hold: shift
ZMK_MOD_MORPH(smart_shft,
    bindings = <&sk LSHFT>, <&caps_word>;
    mods = <(MOD_LSFT)>;
)
&caps_word {  // mods deactivate caps-word, requires PR #1451
    /delete-property/ ignore-modifiers;
};

// tap: sticky num-layer | double-tap: num-word | hold: num-layer
#define SMART_NUM &smart_num NUM 0
ZMK_HOLD_TAP(smart_num,
    flavor = "balanced";
    tapping-term-ms = <200>;
    quick-tap-ms = <QUICK_TAP_MS>;
    bindings = <&mo>, <&num_dance>;
)
ZMK_TAP_DANCE(num_dance,
    tapping-term-ms = <200>;
    bindings = <&sl NUM>, <&num_word NUM>;  // reverse this for sticky num-word
)

// smart-mouse, requires PR #1366
ZMK_TRI_STATE(smart_mouse,
    bindings = <&tog MOUSE>, <&none>, <&tog MOUSE>;
    ignored-key-positions = <LT1 LT3 RT0 RT1 RT2 RT3 RT4 RM0 RM1 RM2 RM3 RM4 RB1 RB2 RB3 RH0 RH1 LH0 LH1 RH0>;
    ignored-layers = <MOUSE NAV FN>;
)

// hold: momentary mouse layer | tap: toggle mouse layer (tap again to exit)
// 3 mouse speeds come from input processors in mouse.dtsi:
//   - base speed: MOUSE only
//   - fast (2x):  MOUSE + NAV (LH0)
//   - precise (1/2): MOUSE + FN (RH0 hold)
ZMK_HOLD_TAP(ht_mouse,
    flavor = "balanced";
    tapping-term-ms = <200>;
    bindings = <&mo>, <&tog>;
)

// hold: FN layer (mouse precision) | tap: left click
ZMK_HOLD_TAP(lt_mkp,
    flavor = "balanced";
    tapping-term-ms = <200>;
    bindings = <&mo>, <&mkp>;
)

// hold: MSCRL layer | tap: G
// balanced + require-prior-idle: during fast typing G taps instantly (no lag),
// hold-tap only engages after an idle pause (i.e. when you deliberately hold G)
ZMK_HOLD_TAP(lt_mscrl,
    flavor = "balanced";
    tapping-term-ms = <200>;
    quick-tap-ms = <QUICK_TAP_MS>;
    require-prior-idle-ms = <150>;
    bindings = <&mo>, <&kp>;
)

/* Custom behaviors */

// reuse basic mod-morph scheme
#define SIMPLE_MORPH(NAME, MOD, BINDING1, BINDING2) \
    ZMK_MOD_MORPH(NAME, \
        mods = <(MOD_L ## MOD|MOD_R ## MOD)>; \
        bindings = <BINDING1>, <BINDING2>; \
    )

// tap: comma | shift + tap: semicolon | ctrl + shift + tap: <
SIMPLE_MORPH(comma_morph, SFT, &kp COMMA, &comma_inner_morph)
SIMPLE_MORPH(comma_inner_morph, CTL, &kp SEMICOLON, &kp LESS_THAN)

// tap: dot | shift + tap: colon | ctrl + shift + tap: >
SIMPLE_MORPH(dot_morph, SFT, &kp DOT, &dot_inner_morph)
SIMPLE_MORPH(dot_inner_morph, CTL, &kp COLON, &kp GREATER_THAN)

// tap: qmark | shift + tap: excl
SIMPLE_MORPH(qexcl, SFT, &kp QMARK, &kp EXCL)
// tap: left/right parenthesis | shft + tap: less-than/greater-than
SIMPLE_MORPH(lpar_lt, SFT, &kp LPAR, &kp LT)
SIMPLE_MORPH(rpar_gt, SFT, &kp RPAR, &kp GT)

// tap: space | shift + tap: dot -> space -> sticky shift | hold: activate layer
ZMK_HOLD_TAP(lt_spc,
    flavor = "balanced";
    tapping-term-ms = <200>;
    quick-tap-ms = <QUICK_TAP_MS>;
    bindings = <&mo>, <&spc_morph>;
)

// original below: 👇
// SIMPLE_MORPH(spc_morph, SFT, &kp SPACE, &dot_spc)

// modified to restore simple space behavior
SIMPLE_MORPH(spc_morph, SFT, &kp SPACE, &kp SPACE)

ZMK_MACRO(dot_spc,
    wait-ms = <0>;
    tap-ms = <5>;
    bindings = <&kp DOT &kp SPACE &sk LSHFT>;
)

// tap: backspace | lshft + tap: delete | rshft + tap: shift-delete
ZMK_MOD_MORPH(bs_del,
    bindings = <&kp BSPC>, <&kp DEL>;
    mods = <(MOD_LSFT|MOD_RSFT)>;
    keep-mods = <MOD_RSFT>;
)

// Windows sleep key
ZMK_MACRO(win_sleep,
    wait-ms = <500>;
    tap-ms = <50>;
    bindings = <&kp LG(X) &kp U &kp S>;
)

// Sticky shift + leader
// ZMK_MACRO(leader_sft, bindings = <&sk LSHFT &leader>;) // edit: leader disabled

// misc aliases
#define CANCEL      &kp K_CANCEL             // cancel caps-word, num-word and smart-mouse
#define DSK_PREV    &hmr LCTRL LG(LC(LEFT))  // previous desktop
#define DSK_NEXT    &hmr LALT LG(LC(RIGHT))  // next     desktop
#define PIN_WIN     &kp LG(LC(LS(Q)))        // pin window across desktops
#define PIN_APP     &kp LG(LC(LS(A)))        // pin application across desktops
#define DSK_MGR     &kp LA(GRAVE)            // desktop manager
#define VOL_DOWN    &hmr RSHFT C_VOL_DN

#include "code.dtsi"

// 1-cell wrapper around copy_cut (ignores param), needed for hold-tap compatibility
ZMK_MACRO_ONE_PARAM(copy_cut_1,
    bindings = <&copy_cut>;
)

// tap: copy_cut | hold: activate REV_NUM layer
ZMK_HOLD_TAP(ht_copy_rev,
    flavor = "tap-preferred";
    tapping-term-ms = <300>;
    bindings = <&mo>, <&copy_cut_1>;
)

/* Keymap */

ZMK_CONDITIONAL_LAYER(sys, NAV NUM, SYS)  // NAV + NUM --> SYS

ZMK_LAYER(base,
//╭────────────────╮ ╭────────────────┬────────────────┬────────────────┬────────────────┬────────────────╮          ╭────────────────┬────────────────┬────────────────┬────────────────┬────────────────╮ ╭────────────────╮
//|      TAB       | |       Q        |       W        |       E        |       R        |       T        |          |       Y        |       U        |       I        |       O        |       P        | |      BSPC      |
    &kp TAB           &kp Q            &kp W            &kp E            &kp R            &kp T                       &kp Y            &kp U            &kp I            &kp O            &kp P                 NAV_BSPC     
//├────────────────┤ ├────────────────┼────────────────┼────────────────┼────────────────┼────────────────┤          ├────────────────┼────────────────┼────────────────┼────────────────┼────────────────┤ ├────────────────┤
//|      DEL       | |       A        |       S        |       D        |       F        |       G        |          |       H        |       J        |       K        |       L        |       '        | |       "        |
    NAV_DEL           &hml LGUI A      &hml LALT S      &hml LCTRL D     &hml LSHFT F     &lt_mscrl MSCRL G           &kp H            &hmr RSHFT J     &hmr LCTRL K     &hmr LALT L      &hmr LGUI SQT        &kp DQT 
//├────────────────┤ ├────────────────┼────────────────┼────────────────┼────────────────┼────────────────┤          ├────────────────┼────────────────┼────────────────┼────────────────┼────────────────┤ ├────────────────┤
//|      MOUSE     | |       Z        |       X        |       C        |       V        |       B        |          |       N        |       M        |       ,        |       .        |       -        | |      ESC       |
    &ht_mouse MOUSE MOUSE &kp Z          &kp X            &kp C            &kp V            &kp B                       &kp N            &kp M            &comma_morph     &dot_morph       &kp MINUS           &kp ESC
//╰────────────────╯ ╰────────────────┼────────────────┴────────────────┼────────────────┼────────────────┤          ├────────────────┼────────────────┼────────────────┴────────────────┴────────────────╯ ╰────────────────╯
                                                        NAV_LEFT         &smart_shft      &lt_spc NAV 0               &lt FN RET       SMART_NUM        NAV_RIGHT
//                                                     ╰────────────────┴────────────────┴────────────────╯          ╰────────────────┴────────────────┴────────────────╯ 
)
    
ZMK_LAYER(nav,
//╭────────────────╮ ╭────────────────┬────────────────┬────────────────┬────────────────┬────────────────╮          ╭────────────────┬────────────────┬────────────────┬────────────────┬────────────────╮ ╭────────────────╮
        ___             ___              &back            &swapper         &forward         ___                        &triple_left     &double_up       NAV_UP           ___              &kp PG_UP          &bspc_two_words
//├────────────────┤ ├────────────────┼────────────────┼────────────────┼────────────────┼────────────────┤          ├────────────────┼────────────────┼────────────────┼────────────────┼────────────────┤ ├────────────────┤
        ___             &sk LGUI         &sk LALT         &kp LCTRL        &sk LSHFT        &mo SPEED                  &one_left        NAV_LEFT         NAV_DOWN         NAV_RIGHT        &one_right           ___
//├────────────────┤ ├────────────────┼────────────────┼────────────────┼────────────────┼────────────────┤          ├────────────────┼────────────────┼────────────────┼────────────────┼────────────────┤ ├────────────────┤
        ___             ___              &sk INS          &mo SPEED        &mo SPEED        ___                        &four_left       &double_down     &triple_down     &four_right      &kp PG_DN            ___
//╰────────────────╯ ╰────────────────┼────────────────┴────────────────┼────────────────┼────────────────┤          ├────────────────┼────────────────┼────────────────┴────────────────┴────────────────╯ ╰────────────────╯
                                                          ___              ___              ___                          ___              CANCEL           ___                                            
//                                                     ╰────────────────┴────────────────┴────────────────╯          ╰────────────────┴────────────────┴────────────────╯ 
)
    
ZMK_LAYER(fn,
//╭────────────────╮ ╭────────────────┬────────────────┬────────────────┬────────────────┬────────────────╮          ╭────────────────┬────────────────┬────────────────┬────────────────┬────────────────╮ ╭────────────────╮
        ___             &kp F12          &kp F7           &e_tap_dance     &kp F9           ___                        &kp C_VOL_UP     &u_accent        &i_accent        &o_accent        &kp C_PREV           &kp C_NEXT        
//├────────────────┤ ├────────────────┼────────────────┼────────────────┼────────────────┼────────────────┤          ├────────────────┼────────────────┼────────────────┼────────────────┼────────────────┤ ├────────────────┤
     &del_two_words     &a_tap_dance     &hml LALT F4     &hml LSHFT F5    &hml LCTRL F6    ___                        VOL_DOWN         &sk LSHFT        &sk LCTRL        &sk LALT         &sk LGUI             &win_sleep 
//├────────────────┤ ├────────────────┼────────────────┼────────────────┼────────────────┼────────────────┤          ├────────────────┼────────────────┼────────────────┼────────────────┼────────────────┤ ├────────────────┤
        ___             &kp F10          &kp F1           &kp F2           &kp F3           DSK_MGR                    &kp PRINTSCREEN  &kp K_CMENU      PIN_WIN          DSK_PREV         DSK_NEXT             &kp C_MUTE
//╰────────────────╯ ╰────────────────┼────────────────┴────────────────┼────────────────┼────────────────┤          ├────────────────┼────────────────┼────────────────┴────────────────┴────────────────╯ ╰────────────────╯
                                                         ___              ___              ___                         DSK_NEXT         &kp C_PP         &type_password                                            
//                                                     ╰────────────────┴────────────────┴────────────────╯          ╰────────────────┴────────────────┴────────────────╯ 
)
    
ZMK_LAYER(num,
//╭────────────────╮ ╭────────────────┬────────────────┬────────────────┬────────────────┬────────────────╮          ╭────────────────┬────────────────┬────────────────┬────────────────┬────────────────╮ ╭────────────────╮
        ___             &kp BSLH         &kp N7           &kp N8           &kp N9           &kp EXCLAMATION            &kp HASH         &kp AMPERSAND    &kp LBKT         &kp RBKT         &kp DOLLAR          ___
//├────────────────┤ ├────────────────┼────────────────┼────────────────┼────────────────┼────────────────┤          ├────────────────┼────────────────┼────────────────┼────────────────┼────────────────┤ ├────────────────┤
        ___             &hml LGUI N0     &hml LALT N4     &hml LCTRL N5    &hml LSHFT N6    &kp DQT           &kp CARET        &hmr RSHFT SINGLE_QUOTE  &hmr LCTRL LPAR  &hmr LALT RPAR  &hmr LGUI GRAVE     ___
//├────────────────┤ ├────────────────┼────────────────┼────────────────┼────────────────┼────────────────┤          ├────────────────┼────────────────┼────────────────┼────────────────┼────────────────┤ ├────────────────┤
        ___             &kp N0           &kp N1           &kp N2           &kp N3           &kp QMARK                  &kp LS(COMMA)    &kp LS(DOT)      &kp LEFT_BRACE   &kp RIGHT_BRACE  &kp AT_SIGN         ___
//╰────────────────╯ ╰────────────────┼────────────────┴────────────────┼────────────────┼────────────────┤          ├────────────────┼────────────────┼────────────────┴────────────────┴────────────────╯ ╰────────────────╯
                                                          ___              ___               ___                         ___              ___              ___                                            
//                                                     ╰────────────────┴────────────────┴────────────────╯          ╰────────────────┴────────────────┴────────────────╯ 
)

ZMK_LAYER(sys,
//╭────────────────╮ ╭────────────────┬────────────────┬────────────────┬────────────────┬────────────────╮          ╭────────────────┬────────────────┬────────────────┬────────────────┬────────────────╮ ╭────────────────╮
     &bt BT_CLR_ALL                                    _BT_SEL_KEYS_                                                   PIN_APP          ___              ___              ___              ___                  ___
//├────────────────┤ ├────────────────┼────────────────┼────────────────┼────────────────┼────────────────┤          ├────────────────┼────────────────┼────────────────┼────────────────┼────────────────┤ ├────────────────┤
        ___             &bootloader      ___              ___              ___              ___                         ___             ___              ___              ___              &bootloader          ___
//├────────────────┤ ├────────────────┼────────────────┼────────────────┼────────────────┼────────────────┤          ├────────────────┼────────────────┼────────────────┼────────────────┼────────────────┤ ├────────────────┤
        &sys_reset      ___              &bt BT_CLR       ___              ___              ___                         ___             ___              ___              ___              ___                  &sys_reset
//╰────────────────╯ ╰────────────────┼────────────────┴────────────────┼────────────────┼────────────────┤          ├────────────────┼────────────────┼────────────────┴────────────────┴────────────────╯ ╰────────────────╯
                                                          ___              ___              ___                         ___             ___              ___                                            
//                                                     ╰────────────────┴────────────────┴────────────────╯          ╰────────────────┴────────────────┴────────────────╯ 
)

ZMK_LAYER(mouse,
//╭────────────────╮ ╭────────────────┬────────────────┬────────────────┬────────────────┬────────────────╮          ╭────────────────┬────────────────┬────────────────┬────────────────┬────────────────╮ ╭────────────────╮
    &tog MOUSE          ___              ___              ___              ___              ___                         U_WH_U           U_WH_L           U_MS_U           U_WH_R           U_WH_U              ___
//├────────────────┤ ├────────────────┼────────────────┼────────────────┼────────────────┼────────────────┤          ├────────────────┼────────────────┼────────────────┼────────────────┼────────────────┤ ├────────────────┤
        ___             ___              &mkp RCLK        &mkp MCLK        &mkp LCLK        ___                         U_WH_D           U_MS_L           U_MS_D           U_MS_R           U_WH_D              ___
//├────────────────┤ ├────────────────┼────────────────┼────────────────┼────────────────┼────────────────┤          ├────────────────┼────────────────┼────────────────┼────────────────┼────────────────┤ ├────────────────┤
        ___             ___              ___              ___              ___              ___                         U_WH_D           &mkp MB4         &mkp MCLK        &mkp MB5         U_WH_D              ___
//╰────────────────╯ ╰────────────────┼────────────────┴────────────────┼────────────────┼────────────────┤          ├────────────────┼────────────────┼────────────────┴────────────────┴────────────────╯ ╰────────────────╯
                                                          &mo FN           ___              ___                         &mkp LCLK        &mkp RCLK        ___                                            
//                                                     ╰────────────────┴────────────────┴────────────────╯          ╰────────────────┴────────────────┴────────────────╯ 
)

ZMK_LAYER(code,
//╭────────────────╮ ╭────────────────┬────────────────┬────────────────┬────────────────┬────────────────╮          ╭────────────────┬────────────────┬────────────────┬────────────────┬────────────────╮ ╭────────────────╮
        ___                                           _BT_SEL_KEYS_                                                    ___              &toggle_editor_size   ___         ___              ___                  ___
//├────────────────┤ ├────────────────┼────────────────┼────────────────┼────────────────┼────────────────┤          ├────────────────┼────────────────┼────────────────┼────────────────┼────────────────┤ ├────────────────┤
        ___             &ctrl1           &ctrl2           &ctrl3           ___              ___                         &kp B           &duplicate_line  &comment_uncomment ___            ___                  ___
//├────────────────┤ ├────────────────┼────────────────┼────────────────┼────────────────┼────────────────┤          ├────────────────┼────────────────┼────────────────┼────────────────┼────────────────┤ ├────────────────┤
        ___             ___              ___              &focus_chat      ___              ___                         ___             &fold_unfold     ___              &quick_fix       ___                  ___
//╰────────────────╯ ╰────────────────┼────────────────┴────────────────┼────────────────┼────────────────┤          ├────────────────┼────────────────┼────────────────┴────────────────┴────────────────╯ ╰────────────────╯
                                                          ___              ___              ___                         &oc_agent_left   &oc_enter_exit_agents ___                                            
//                                                     ╰────────────────┴────────────────┴────────────────╯          ╰────────────────┴────────────────┴────────────────╯ 
)

ZMK_LAYER(accents,
//╭────────────────╮ ╭────────────────┬────────────────┬────────────────┬────────────────┬────────────────╮          ╭────────────────┬────────────────┬────────────────┬────────────────┬────────────────╮ ╭────────────────╮
        ___             ___              ___              &e_accent        ___              ___                        ___              &u_accent        &i_accent        &o_accent        ___                  ___
//├────────────────┤ ├────────────────┼────────────────┼────────────────┼────────────────┼────────────────┤          ├────────────────┼────────────────┼────────────────┼────────────────┼────────────────┤ ├────────────────┤
        ___             &a_accent        ___              ___              ___              ___                        ___              ___              ___              ___              ___                  ___
//├────────────────┤ ├────────────────┼────────────────┼────────────────┼────────────────┼────────────────┤          ├────────────────┼────────────────┼────────────────┼────────────────┼────────────────┤ ├────────────────┤
        ___             ___              ___              ___              ___              ___                        ___              ___              ___              ___              ___                  ___
//╰────────────────╯ ╰────────────────┼────────────────┴────────────────┼────────────────┼────────────────┤          ├────────────────┼────────────────┼────────────────┴────────────────┴────────────────╯ ╰────────────────╯
                                                          ___              ___              ___                        ___              ___              ___                                            
//                                                     ╰────────────────┴────────────────┴────────────────╯          ╰────────────────┴────────────────┴────────────────╯ 
)


ZMK_LAYER(rev_num,
//╭────────────────╮ ╭────────────────┬────────────────┬────────────────┬────────────────┬────────────────╮          ╭────────────────┬────────────────┬────────────────┬────────────────┬────────────────╮ ╭────────────────╮
        ___             ___              ___              ___              ___              ___                        ___              &kp N7           &kp N8           &kp N9           ___                  ___
//├────────────────┤ ├────────────────┼────────────────┼────────────────┼────────────────┼────────────────┤          ├────────────────┼────────────────┼────────────────┼────────────────┼────────────────┤ ├────────────────┤
        ___             ___              ___              ___              ___              ___                        ___              &kp N4           &kp N5           &kp N6           ___                  ___
//├────────────────┤ ├────────────────┼────────────────┼────────────────┼────────────────┼────────────────┤          ├────────────────┼────────────────┼────────────────┼────────────────┼────────────────┤ ├────────────────┤
        ___             ___              ___              ___              ___              ___                        ___              &kp N1           &kp N2           &kp N3           ___                  ___
//╰────────────────╯ ╰────────────────┼────────────────┴────────────────┼────────────────┼────────────────┤          ├────────────────┼────────────────┼────────────────┴────────────────┴────────────────╯ ╰────────────────╯
                                                          ___              ___              ___                        &kp N0          &kp DOT           ___                                            
//                                                     ╰────────────────┴────────────────┴────────────────╯          ╰────────────────┴────────────────┴────────────────╯ 
)


ZMK_LAYER(speed,
//╭────────────────╮ ╭────────────────┬────────────────┬────────────────┬────────────────┬────────────────╮          ╭────────────────┬────────────────┬────────────────┬────────────────┬────────────────╮ ╭────────────────╮
        ___             ___              ___              ___              ___              ___                        ___              &triple_up       &ten_up          ___              ___                  ___
//├────────────────┤ ├────────────────┼────────────────┼────────────────┼────────────────┼────────────────┤          ├────────────────┼────────────────┼────────────────┼────────────────┼────────────────┤ ├────────────────┤
        ___             ___              ___              ___              ___              ___                        &triple_left     &double_left     &ten_down        &double_right    &triple_right       ___
//├────────────────┤ ├────────────────┼────────────────┼────────────────┼────────────────┼────────────────┤          ├────────────────┼────────────────┼────────────────┼────────────────┼────────────────┤ ├────────────────┤
        ___             ___              ___              ___              ___              ___                        ___              ___              &triple_down     ___              ___                  ___
//╰────────────────╯ ╰────────────────┼────────────────┴────────────────┼────────────────┼────────────────┤          ├────────────────┼────────────────┼────────────────┴────────────────┴────────────────╯ ╰────────────────╯
                                                          ___              ___              ___                        ___              ___              ___
//                                                     ╰────────────────┴────────────────┴────────────────╯          ╰────────────────┴────────────────┴────────────────╯
)

ZMK_LAYER(mscrl,
//╭────────────────╮ ╭────────────────┬────────────────┬────────────────┬────────────────┬────────────────╮          ╭────────────────┬────────────────┬────────────────┬────────────────┬────────────────╮ ╭────────────────╮
        ___             ___              ___              ___              ___              ___                        ___              ___              ___              ___              ___                  ___
//├────────────────┤ ├────────────────┼────────────────┼────────────────┼────────────────┼────────────────┤          ├────────────────┼────────────────┼────────────────┼────────────────┼────────────────┤ ├────────────────┤
        ___             ___              ___              ___              ___              ___                        ___              ___              ___              ___              ___                  ___
//├────────────────┤ ├────────────────┼────────────────┼────────────────┼────────────────┼────────────────┤          ├────────────────┼────────────────┼────────────────┼────────────────┼────────────────┤ ├────────────────┤
        ___             ___              ___              ___              ___              ___                        ___              ___              ___              ___              ___                  ___
//╰────────────────╯ ╰────────────────┼────────────────┴────────────────┼────────────────┼────────────────┤          ├────────────────┼────────────────┼────────────────┴────────────────┴────────────────╯ ╰────────────────╯
                                                          ___              ___              ___                        ___              ___              ___
//                                                     ╰────────────────┴────────────────┴────────────────╯          ╰────────────────┴────────────────┴────────────────╯
)

/* vim: set ft=c tw=174: */
